## CMakeLists.txt
```
# SPDX-License-Identifier: Apache-2.0
cmake_minimum_required(VERSION 3.20.0)
list(APPEND ZEPHYR_EXTRA_MODULES ${CMAKE_CURRENT_SOURCE_DIR}/../..)
find_package(Zephyr REQUIRED HINTS $ENV{ZEPHYR_BASE})
project(libharu_tests)
target_sources(app PRIVATE src/main.c src/components.c src/memory.c)
target_sources_ifdef(CONFIG_LIBHARU_FILE_SUPPORT app PRIVATE src/file_support.c)
```

## prj.conf
```kconfig
# SPDX-License-Identifier: Apache-2.0
CONFIG_ZTEST=y
CONFIG_PICOLIBC=y
# Composite encoders allocate two 256 x 256 16-bit maps.
CONFIG_COMMON_LIBC_MALLOC_ARENA_SIZE=524288
CONFIG_MAIN_STACK_SIZE=4096
CONFIG_TEST_EXTRA_STACK_SIZE=16384
CONFIG_LIBHARU=y
# Heap statistics for the leak checks.
CONFIG_SYS_HEAP_RUNTIME_STATS=y
```

## file_support.conf
```kconfig
# SPDX-License-Identifier: Apache-2.0
# Exercise the file APIs on an ext2 volume in a RAM disk.
CONFIG_LIBHARU_FILE_SUPPORT=y
CONFIG_FILE_SYSTEM=y
CONFIG_FILE_SYSTEM_EXT2=y
CONFIG_FILE_SYSTEM_MKFS=y
CONFIG_DISK_ACCESS=y
# ext2 formatting needs a random source.
CONFIG_TEST_RANDOM_GENERATOR=y
```

## minimal.conf
```kconfig
# SPDX-License-Identifier: Apache-2.0
# Keep only the Helvetica family used by this sample.
CONFIG_LIBHARU_FONT_COURIER=n
CONFIG_LIBHARU_FONT_TIMES=n
CONFIG_LIBHARU_FONT_SYMBOL=n
CONFIG_LIBHARU_FONT_ZAPF_DINGBATS=n
CONFIG_LIBHARU_TRUETYPE=n
CONFIG_LIBHARU_ENCRYPTION=n
CONFIG_LIBHARU_PDFA=n
```

## no_builtin_fonts.conf
```kconfig
# SPDX-License-Identifier: Apache-2.0
# Combine with minimal.conf to exercise the empty built-in font table.
CONFIG_LIBHARU_FONT_HELVETICA=n
```

## pdfa.conf
```kconfig
# SPDX-License-Identifier: Apache-2.0
# Exercise the shared MD5 dependency without password encryption.
CONFIG_LIBHARU_ENCRYPTION=n
```

## truetype.conf
```kconfig
# SPDX-License-Identifier: Apache-2.0
# Keep TrueType/UTF-8 without the regional font and encoding tables.
CONFIG_LIBHARU_FONT_JP=n
CONFIG_LIBHARU_FONT_KR=n
CONFIG_LIBHARU_FONT_CNS=n
CONFIG_LIBHARU_FONT_CNT=n
CONFIG_LIBHARU_PDFA=n
```

## ramdisk.overlay
```dts
/* SPDX-License-Identifier: Apache-2.0 */

/ {
	ramdisk0 {
		compatible = "zephyr,ram-disk";
		disk-name = "RAM";
		sector-size = <512>;
		sector-count = <220>;
	};
};
```

## src/main.c
```c
/* SPDX-License-Identifier: Apache-2.0 */
#include <string.h>
#include <hpdf.h>
#include <zephyr/ztest.h>

static HPDF_Doc pdf;
static HPDF_STATUS last_error;

static void error_handler(HPDF_STATUS error, HPDF_STATUS detail, void *user_data)
{
	HPDF_STATUS *saved_error = user_data;

	ARG_UNUSED(detail);
	*saved_error = error;
}

static void before(void *fixture)
{
	ARG_UNUSED(fixture);
	last_error = HPDF_OK;
	pdf = HPDF_New(error_handler, &last_error);
	zassert_not_null(pdf);
}

static void after(void *fixture)
{
	ARG_UNUSED(fixture);
	HPDF_Free(pdf);
	pdf = NULL;
}

ZTEST(libharu, test_document_lifecycle)
{
	zassert_true(HPDF_HasDoc(pdf));
	HPDF_FreeDoc(pdf);
	zassert_false(HPDF_HasDoc(pdf));
	zassert_equal(HPDF_NewDoc(pdf), HPDF_OK);
	zassert_true(HPDF_HasDoc(pdf));
	zassert_not_null(HPDF_AddPage(pdf));
}

ZTEST(libharu, test_metadata_and_pages)
{
	HPDF_Page first = HPDF_AddPage(pdf);
	HPDF_Page second = HPDF_AddPage(pdf);

	zassert_not_null(first);
	zassert_not_null(second);
	zassert_not_equal(first, second);
	zassert_equal(HPDF_Page_SetWidth(first, 300), HPDF_OK);
	zassert_equal(HPDF_Page_SetHeight(first, 400), HPDF_OK);
	zassert_equal(HPDF_Page_GetWidth(first), 300);
	zassert_equal(HPDF_Page_GetHeight(first), 400);
	zassert_equal(HPDF_SetInfoAttr(pdf, HPDF_INFO_TITLE, "Zephyr report"), HPDF_OK);
	zassert_str_equal(HPDF_GetInfoAttr(pdf, HPDF_INFO_TITLE), "Zephyr report");
}

#ifdef CONFIG_LIBHARU_FONT_HELVETICA
ZTEST(libharu, test_text_and_stream)
{
	HPDF_Page page = HPDF_AddPage(pdf);
	HPDF_Font font = HPDF_GetFont(pdf, "Helvetica", NULL);
	HPDF_BYTE buffer[37];
	HPDF_BYTE tail[6] = {0};
	HPDF_UINT32 total = 0;
	HPDF_UINT32 expected;
	HPDF_UINT32 size;

	zassert_not_null(page);
	zassert_not_null(font);
	zassert_equal(HPDF_Page_BeginText(page), HPDF_OK);
	zassert_equal(HPDF_Page_SetFontAndSize(page, font, 12), HPDF_OK);
	zassert_equal(HPDF_Page_TextOut(page, 50, 100, "Zephyr PDF"), HPDF_OK);
	zassert_equal(HPDF_Page_EndText(page), HPDF_OK);
	zassert_equal(HPDF_SaveToStream(pdf), HPDF_OK);
	expected = HPDF_GetStreamSize(pdf);
	zassert_true(expected > sizeof(buffer));
	zassert_equal(HPDF_ResetStream(pdf), HPDF_OK);

	while (total < expected) {
		HPDF_STATUS status;

		size = sizeof(buffer);
		status = HPDF_ReadFromStream(pdf, buffer, &size);
		zassert_true(status == HPDF_OK || status == HPDF_STREAM_EOF);
		zassert_true(size > 0 && size <= sizeof(buffer));
		if (total == 0) {
			zassert_mem_equal(buffer, "%PDF-", 5);
		}
		for (HPDF_UINT32 i = 0; i < size; i++) {
			memmove(tail, tail + 1, sizeof(tail) - 1);
			tail[sizeof(tail) - 1] = buffer[i];
		}
		total += size;
	}

	zassert_equal(total, expected);
	zassert_mem_equal(tail, "%%EOF\n", sizeof(tail));
	size = sizeof(buffer);
	zassert_equal(HPDF_ReadFromStream(pdf, buffer, &size), HPDF_STREAM_EOF);
	zassert_equal(size, 0);
	zassert_equal(HPDF_ResetStream(pdf), HPDF_OK);
	size = 5;
	zassert_equal(HPDF_ReadFromStream(pdf, buffer, &size), HPDF_OK);
	zassert_mem_equal(buffer, "%PDF-", 5);
}

#endif

ZTEST(libharu, test_error_callback_and_recovery)
{
	HPDF_Page page = HPDF_AddPage(pdf);

	zassert_not_null(page);
	zassert_equal(HPDF_Page_SetWidth(page, 0), HPDF_PAGE_INVALID_SIZE);
	zassert_equal(last_error, HPDF_PAGE_INVALID_SIZE);
	zassert_equal(HPDF_GetError(pdf), HPDF_PAGE_INVALID_SIZE);
	HPDF_ResetError(pdf);
	zassert_equal(HPDF_GetError(pdf), HPDF_OK);
	zassert_equal(HPDF_Page_SetWidth(page, 300), HPDF_OK);
}

ZTEST(libharu, test_raw_image)
{
	static const HPDF_BYTE pixels[] = {255, 0, 0, 0, 255, 0};
	HPDF_Page page = HPDF_AddPage(pdf);
	HPDF_Image image = HPDF_LoadRawImageFromMem(pdf, pixels, 2, 1,
						  HPDF_CS_DEVICE_RGB, 8);

	zassert_not_null(page);
	zassert_not_null(image);
	zassert_equal(HPDF_Image_GetWidth(image), 2);
	zassert_equal(HPDF_Image_GetHeight(image), 1);
	zassert_equal(HPDF_Page_DrawImage(page, image, 20, 20, 100, 50), HPDF_OK);
	zassert_equal(HPDF_SaveToStream(pdf), HPDF_OK);
	zassert_true(HPDF_GetStreamSize(pdf) > 0);
}

ZTEST_SUITE(libharu, NULL, NULL, before, after, NULL);
```

## src/components.c
```c
// SPDX-License-Identifier: Apache-2.0
#include <hpdf.h>
#include <zephyr/sys/util.h>
#include <zephyr/ztest.h>

static HPDF_Doc pdf;

static void before(void *fixture)
{
	ARG_UNUSED(fixture);
	pdf = HPDF_New(NULL, NULL);
	zassert_not_null(pdf);
}

static void after(void *fixture)
{
	ARG_UNUSED(fixture);
	HPDF_Free(pdf);
	pdf = NULL;
}

ZTEST(components, test_builtin_font_selection)
{
	static const struct {
		const char *name;
		bool enabled;
	} fonts[] = {
		{"Helvetica", IS_ENABLED(CONFIG_LIBHARU_FONT_HELVETICA)},
		{"Helvetica-BoldOblique", IS_ENABLED(CONFIG_LIBHARU_FONT_HELVETICA)},
		{"Courier", IS_ENABLED(CONFIG_LIBHARU_FONT_COURIER)},
		{"Courier-BoldOblique", IS_ENABLED(CONFIG_LIBHARU_FONT_COURIER)},
		{"Times-Roman", IS_ENABLED(CONFIG_LIBHARU_FONT_TIMES)},
		{"Times-BoldItalic", IS_ENABLED(CONFIG_LIBHARU_FONT_TIMES)},
		{"Symbol", IS_ENABLED(CONFIG_LIBHARU_FONT_SYMBOL)},
		{"ZapfDingbats", IS_ENABLED(CONFIG_LIBHARU_FONT_ZAPF_DINGBATS)},
	};

	for (size_t i = 0; i < ARRAY_SIZE(fonts); i++) {
		HPDF_Font font = HPDF_GetFont(pdf, fonts[i].name, NULL);

		if (fonts[i].enabled) {
			zassert_not_null(font, "%s must be available", fonts[i].name);
		} else {
			zassert_is_null(font, "%s must be excluded", fonts[i].name);
			zassert_equal(HPDF_GetError(pdf), HPDF_INVALID_FONT_NAME);
		}
		HPDF_ResetError(pdf);
	}
}

#ifdef CONFIG_LIBHARU_TRUETYPE
ZTEST(components, test_invalid_truetype)
{
	static const HPDF_BYTE invalid_font[16] = {0};

	zassert_is_null(HPDF_LoadTTFontFromMemory(pdf, invalid_font,
						sizeof(invalid_font), HPDF_TRUE));
	zassert_not_equal(HPDF_GetError(pdf), HPDF_OK);
}
#endif

#ifdef CONFIG_LIBHARU_ENCODING_UTF
ZTEST(components, test_utf8_registration)
{
	zassert_equal(HPDF_UseUTFEncodings(pdf), HPDF_OK);
	zassert_not_null(HPDF_GetEncoder(pdf, "UTF-8"));
}
#endif

#ifdef CONFIG_LIBHARU_ENCRYPTION
ZTEST(components, test_encrypted_document)
{
	zassert_not_null(HPDF_AddPage(pdf));
	zassert_equal(HPDF_SetPassword(pdf, "owner", "reader"), HPDF_OK);
	zassert_equal(HPDF_SetPermission(pdf, HPDF_ENABLE_READ), HPDF_OK);
	zassert_equal(HPDF_SetEncryptionMode(pdf, HPDF_ENCRYPT_R3, 16), HPDF_OK);
	zassert_equal(HPDF_SaveToStream(pdf), HPDF_OK);
	zassert_true(HPDF_GetStreamSize(pdf) > 0);
}
#endif

#ifdef CONFIG_LIBHARU_PDFA
ZTEST(components, test_pdfa_metadata)
{
	zassert_not_null(HPDF_AddPage(pdf));
	zassert_equal(HPDF_SetPDFAConformance(pdf, HPDF_PDFA_1B), HPDF_OK);
	zassert_equal(HPDF_SetInfoAttr(pdf, HPDF_INFO_TITLE, "PDF/A metadata"), HPDF_OK);
	zassert_equal(HPDF_SaveToStream(pdf), HPDF_OK);
	zassert_true(HPDF_GetStreamSize(pdf) > 0);
}
#endif

#ifdef CONFIG_LIBHARU_FONT_JP
ZTEST(components, test_jp_registration)
{
	zassert_equal(HPDF_UseJPFonts(pdf), HPDF_OK);
	zassert_equal(HPDF_UseJPEncodings(pdf), HPDF_OK);
	zassert_not_null(HPDF_GetFont(pdf, "MS-Mincho", "90ms-RKSJ-H"));
}
#endif

#ifdef CONFIG_LIBHARU_FONT_KR
ZTEST(components, test_kr_registration)
{
	zassert_equal(HPDF_UseKRFonts(pdf), HPDF_OK);
	zassert_equal(HPDF_UseKREncodings(pdf), HPDF_OK);
	zassert_not_null(HPDF_GetFont(pdf, "DotumChe", "KSC-EUC-H"));
}
#endif

#ifdef CONFIG_LIBHARU_FONT_CNS
ZTEST(components, test_cns_registration)
{
	zassert_equal(HPDF_UseCNSFonts(pdf), HPDF_OK);
	zassert_equal(HPDF_UseCNSEncodings(pdf), HPDF_OK);
	zassert_not_null(HPDF_GetFont(pdf, "SimSun", "GB-EUC-H"));
}
#endif

#ifdef CONFIG_LIBHARU_FONT_CNT
ZTEST(components, test_cnt_registration)
{
	zassert_equal(HPDF_UseCNTFonts(pdf), HPDF_OK);
	zassert_equal(HPDF_UseCNTEncodings(pdf), HPDF_OK);
	zassert_not_null(HPDF_GetFont(pdf, "MingLiU", "ETen-B5-H"));
}
#endif

ZTEST_SUITE(components, NULL, NULL, before, after, NULL);
```

## src/file_support.c
```c
/* SPDX-License-Identifier: Apache-2.0 */
#include <hpdf.h>
#include <zephyr/fs/fs.h>
/* After fs.h: ext2.h uses bool without including stdbool.h. */
#include <zephyr/fs/ext2.h>
#include <zephyr/ztest.h>

#define MOUNT_POINT "/ram"

static struct fs_mount_t mount = {
	.type = FS_EXT2,
	.mnt_point = MOUNT_POINT,
	.storage_dev = "RAM",
	.flags = FS_MOUNT_FLAG_NO_FORMAT,
};

static HPDF_Doc pdf;

static void *setup(void)
{
	/* The ext2 driver logs the UUID as a string: keep it printable. */
	static struct ext2_cfg cfg = {
		.block_size = 1024,
		.uuid = "libharu-test-fs",
		.volume_name = "libharu",
		.set_uuid = true,
	};

	zassert_ok(fs_mkfs(FS_EXT2, (uintptr_t)mount.storage_dev, &cfg, 0));
	zassert_ok(fs_mount(&mount));
	return NULL;
}

static void teardown(void *fixture)
{
	ARG_UNUSED(fixture);
	fs_unmount(&mount);
}

static void before(void *fixture)
{
	ARG_UNUSED(fixture);
	pdf = HPDF_New(NULL, NULL);
	zassert_not_null(pdf);
}

static void after(void *fixture)
{
	ARG_UNUSED(fixture);
	HPDF_Free(pdf);
	pdf = NULL;
}

ZTEST(file_support, test_save_to_file)
{
	struct fs_dirent entry;
	struct fs_file_t file;
	char header[5];
	HPDF_UINT32 expected;

	fs_file_t_init(&file);
	zassert_not_null(HPDF_AddPage(pdf));
	zassert_equal(HPDF_SaveToStream(pdf), HPDF_OK);
	expected = HPDF_GetStreamSize(pdf);

	zassert_equal(HPDF_SaveToFile(pdf, MOUNT_POINT "/out.pdf"), HPDF_OK);
	zassert_ok(fs_stat(MOUNT_POINT "/out.pdf", &entry));
	zassert_equal(entry.size, expected, "file has %zu bytes, stream %u", entry.size,
		      expected);

	zassert_ok(fs_open(&file, MOUNT_POINT "/out.pdf", FS_O_READ));
	zassert_equal(fs_read(&file, header, sizeof(header)), sizeof(header));
	zassert_ok(fs_close(&file));
	zassert_mem_equal(header, "%PDF-", sizeof(header));
}

ZTEST(file_support, test_load_raw_image_from_file)
{
	static const HPDF_BYTE pixels[] = {255, 0, 0, 0, 255, 0};
	struct fs_file_t file;
	HPDF_Image image;

	fs_file_t_init(&file);
	zassert_ok(fs_open(&file, MOUNT_POINT "/image.rgb", FS_O_CREATE | FS_O_WRITE));
	zassert_equal(fs_write(&file, pixels, sizeof(pixels)), sizeof(pixels));
	zassert_ok(fs_close(&file));

	image = HPDF_LoadRawImageFromFile(pdf, MOUNT_POINT "/image.rgb", 2, 1,
					  HPDF_CS_DEVICE_RGB);
	zassert_not_null(image);
	zassert_equal(HPDF_Image_GetWidth(image), 2);
	zassert_equal(HPDF_Image_GetHeight(image), 1);
}

ZTEST(file_support, test_missing_file)
{
	zassert_is_null(HPDF_LoadRawImageFromFile(pdf, MOUNT_POINT "/missing.rgb", 2, 1,
						  HPDF_CS_DEVICE_RGB));
	zassert_equal(HPDF_GetError(pdf), HPDF_FILE_OPEN_ERROR);
}

ZTEST_SUITE(file_support, NULL, setup, before, after, teardown);
```

## src/memory.c
```c
/* SPDX-License-Identifier: Apache-2.0 */
#include <stdlib.h>
#include <hpdf.h>
#include <sys_malloc.h>
#include <zephyr/ztest.h>

/* Upper bound on allocations for the small document below. */
#define MAX_ALLOCATIONS 5000

static HPDF_STATUS last_error;

static void error_handler(HPDF_STATUS error, HPDF_STATUS detail, void *user_data)
{
	ARG_UNUSED(detail);
	ARG_UNUSED(user_data);
	last_error = error;
}

/* Exercise text, graphics, an image and serialization; report the first failure. */
static HPDF_STATUS build_document(HPDF_Doc pdf)
{
	static const HPDF_BYTE pixels[] = {255, 0, 0, 0, 255, 0};
	HPDF_Page page = HPDF_AddPage(pdf);
	HPDF_Image image;

	if (page == NULL) {
		return HPDF_GetError(pdf);
	}
#ifdef CONFIG_LIBHARU_FONT_HELVETICA
	HPDF_Font font = HPDF_GetFont(pdf, "Helvetica", NULL);

	if (font == NULL || HPDF_Page_BeginText(page) != HPDF_OK ||
	    HPDF_Page_SetFontAndSize(page, font, 12) != HPDF_OK ||
	    HPDF_Page_TextOut(page, 50, 100, "Memory test") != HPDF_OK ||
	    HPDF_Page_EndText(page) != HPDF_OK) {
		return HPDF_GetError(pdf);
	}
#endif
	if (HPDF_Page_Rectangle(page, 20, 20, 200, 100) != HPDF_OK ||
	    HPDF_Page_Stroke(page) != HPDF_OK) {
		return HPDF_GetError(pdf);
	}
	image = HPDF_LoadRawImageFromMem(pdf, pixels, 2, 1, HPDF_CS_DEVICE_RGB, 8);
	if (image == NULL || HPDF_Page_DrawImage(page, image, 20, 140, 100, 50) != HPDF_OK) {
		return HPDF_GetError(pdf);
	}
	if (HPDF_SetInfoAttr(pdf, HPDF_INFO_TITLE, "Memory test") != HPDF_OK) {
		return HPDF_GetError(pdf);
	}
	return HPDF_SaveToStream(pdf);
}

static size_t heap_allocated(void)
{
	struct sys_memory_stats stats;

	zassert_ok(malloc_runtime_stats_get(&stats));
	return stats.allocated_bytes;
}

ZTEST(memory, test_no_leak_after_free)
{
	size_t baseline = heap_allocated();

	/* Repeat to catch growth that a single cycle could hide. */
	for (int i = 0; i < 3; i++) {
		HPDF_Doc pdf = HPDF_New(error_handler, NULL);

		zassert_not_null(pdf);
		zassert_equal(build_document(pdf), HPDF_OK);
		HPDF_Free(pdf);
		zassert_equal(heap_allocated(), baseline, "cycle %d leaked %zu bytes", i,
			      heap_allocated() - baseline);
	}
}

ZTEST(memory, test_unbalanced_gsave_no_leak)
{
	size_t baseline = heap_allocated();
	HPDF_Doc pdf = HPDF_New(error_handler, NULL);
	HPDF_Page page;

	zassert_not_null(pdf);
	page = HPDF_AddPage(pdf);
	zassert_not_null(page);
	/* Saved graphics states must be released even without GRestore. */
	zassert_equal(HPDF_Page_GSave(page), HPDF_OK);
	zassert_equal(HPDF_Page_GSave(page), HPDF_OK);
	HPDF_Free(pdf);
	zassert_equal(heap_allocated(), baseline);
}

/* Allocator that fails once its budget is spent and counts live blocks. */
static int alloc_budget;
static int live_blocks;

static void *budget_alloc(HPDF_UINT size)
{
	void *ptr;

	if (alloc_budget == 0) {
		return NULL;
	}
	ptr = malloc(size);
	if (ptr != NULL) {
		alloc_budget--;
		live_blocks++;
	}
	return ptr;
}

static void budget_free(void *ptr)
{
	if (ptr != NULL) {
		live_blocks--;
		free(ptr);
	}
}

ZTEST(memory, test_allocation_failures)
{
	size_t baseline = heap_allocated();
	int budget;

	/* Fail at every allocation in turn until the whole document succeeds. */
	for (budget = 0; budget < MAX_ALLOCATIONS; budget++) {
		HPDF_STATUS status = HPDF_FAILED_TO_ALLOC_MEM;
		HPDF_Doc pdf;

		alloc_budget = budget;
		live_blocks = 0;
		last_error = HPDF_OK;
		/* No memory pool, so each object goes through budget_alloc(). */
		pdf = HPDF_NewEx(error_handler, budget_alloc, budget_free, 0, NULL);
		if (pdf != NULL) {
			status = build_document(pdf);
			HPDF_Free(pdf);
		}
		zassert_equal(live_blocks, 0, "failure at allocation %d leaked %d blocks",
			      budget, live_blocks);
		if (status == HPDF_OK) {
			break;
		}
		if (pdf != NULL) {
			zassert_not_equal(last_error, HPDF_OK,
					  "failure at allocation %d was not reported", budget);
		}
	}

	zassert_true(budget > 0, "document built without allocating");
	zassert_true(budget < MAX_ALLOCATIONS, "document never completed");
	zassert_equal(heap_allocated(), baseline);
	TC_PRINT("document needs %d allocations\n", budget);
}

ZTEST_SUITE(memory, NULL, NULL, NULL, NULL, NULL);
```
