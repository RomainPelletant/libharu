## CMakeLists.txt
```
# SPDX-License-Identifier: Apache-2.0
cmake_minimum_required(VERSION 3.20.0)
list(APPEND ZEPHYR_EXTRA_MODULES ${CMAKE_CURRENT_SOURCE_DIR}/../..)
find_package(Zephyr REQUIRED HINTS $ENV{ZEPHYR_BASE})
project(encrypted_pdf)
target_sources(app PRIVATE src/main.c ../common/pdf_output.c)
target_include_directories(app PRIVATE ../common)
```

## sample.yaml
```
# SPDX-License-Identifier: Apache-2.0
sample:
  name: Libharu encrypted PDF
  description: Generate a password-protected PDF using RC4-128
common:
  tags:
    - libharu
  min_flash: 2048
  min_ram: 256
  integration_platforms:
    - nucleo_u575zi_q
    - qemu_cortex_a53
    - mps2/an385
  harness: console
  harness_config:
    type: one_line
    regex:
      - "PDF-END"
tests:
  sample.libharu.encrypted_pdf: {}
```

## prj.conf
```kconfig
# SPDX-License-Identifier: Apache-2.0
CONFIG_PICOLIBC=y
CONFIG_COMMON_LIBC_MALLOC_ARENA_SIZE=40072
# Stream serialization uses input and encrypted-output buffers on the stack.
CONFIG_MAIN_STACK_SIZE=16384
CONFIG_LIBHARU=y
CONFIG_LIBHARU_FONT_HELVETICA=y
CONFIG_LIBHARU_ENCRYPTION=y

# This document only needs Helvetica and password encryption.
CONFIG_LIBHARU_FONT_COURIER=n
CONFIG_LIBHARU_FONT_TIMES=n
CONFIG_LIBHARU_FONT_SYMBOL=n
CONFIG_LIBHARU_FONT_ZAPF_DINGBATS=n
CONFIG_LIBHARU_TRUETYPE=n
CONFIG_LIBHARU_PDFA=n

CONFIG_PRINTK=y
CONFIG_CONSOLE=y
CONFIG_SERIAL=y
CONFIG_UART_CONSOLE=y
```

## src/main.c
```c
// SPDX-License-Identifier: Apache-2.0
#include <errno.h>
#include <zephyr/sys/printk.h>

#include "pdf_output.h"

/* Demonstration credentials only; applications must supply their own. */
static const char owner_password[] = "zephyr-owner";
static const char reader_password[] = "zephyr-reader";

int main(void)
{
	HPDF_Doc pdf = HPDF_New(NULL, NULL);
	HPDF_Page page;
	HPDF_Font font;
	int ret = -EIO;

	if (pdf == NULL) {
		printk("Cannot allocate PDF document\n");
		return -ENOMEM;
	}

	/* SetPassword creates the encryption dictionary used by the next calls. */
	if (HPDF_SetPassword(pdf, owner_password, reader_password) != HPDF_OK ||
	    HPDF_SetEncryptionMode(pdf, HPDF_ENCRYPT_R3, 16) != HPDF_OK ||
	    HPDF_SetPermission(pdf, HPDF_ENABLE_READ | HPDF_ENABLE_PRINT) != HPDF_OK) {
		goto out;
	}

	page = HPDF_AddPage(pdf);
	font = HPDF_GetFont(pdf, "Helvetica", NULL);
	if (page == NULL || font == NULL) {
		goto out;
	}

	if (HPDF_SetInfoAttr(pdf, HPDF_INFO_TITLE, "Encrypted Zephyr PDF") != HPDF_OK ||
	    HPDF_Page_SetSize(page, HPDF_PAGE_SIZE_A4, HPDF_PAGE_PORTRAIT) != HPDF_OK ||
	    HPDF_Page_BeginText(page) != HPDF_OK ||
	    HPDF_Page_SetFontAndSize(page, font, 20) != HPDF_OK ||
	    HPDF_Page_TextOut(page, 50, 780, "Password-protected PDF") != HPDF_OK ||
	    HPDF_Page_SetFontAndSize(page, font, 12) != HPDF_OK ||
	    HPDF_Page_TextOut(page, 50, 740, "Generated by libharu on Zephyr.") != HPDF_OK ||
	    HPDF_Page_EndText(page) != HPDF_OK) {
		goto out;
	}

	ret = pdf_output(pdf, "encrypted.pdf");
out:
	if (ret != 0) {
		printk("PDF generation failed: 0x%lx\n", (unsigned long)HPDF_GetError(pdf));
	}
	HPDF_Free(pdf);
	return ret;
}
```
