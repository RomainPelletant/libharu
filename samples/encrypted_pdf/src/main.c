// SPDX-License-Identifier: Apache-2.0
#include <errno.h>
#include <zephyr/sys/printk.h>

#include "pdf_output.h"

/* Demonstration credentials only; applications must supply their own. */
static const char owner_password[] = "zephyr-owner";
static const char reader_password[] = "zephyr-reader";

int main(void)
{
	HPDF_Doc pdf = HPDF_New(NULL, NULL);
	HPDF_Page page;
	HPDF_Font font;
	int ret = -EIO;

	if (pdf == NULL) {
		printk("Cannot allocate PDF document\n");
		return -ENOMEM;
	}

	/* SetPassword creates the encryption dictionary used by the next calls. */
	if (HPDF_SetPassword(pdf, owner_password, reader_password) != HPDF_OK ||
	    HPDF_SetEncryptionMode(pdf, HPDF_ENCRYPT_R3, 16) != HPDF_OK ||
	    HPDF_SetPermission(pdf, HPDF_ENABLE_READ | HPDF_ENABLE_PRINT) != HPDF_OK) {
		goto out;
	}

	page = HPDF_AddPage(pdf);
	font = HPDF_GetFont(pdf, "Helvetica", NULL);
	if (page == NULL || font == NULL) {
		goto out;
	}

	if (HPDF_SetInfoAttr(pdf, HPDF_INFO_TITLE, "Encrypted Zephyr PDF") != HPDF_OK ||
	    HPDF_Page_SetSize(page, HPDF_PAGE_SIZE_A4, HPDF_PAGE_PORTRAIT) != HPDF_OK ||
	    HPDF_Page_BeginText(page) != HPDF_OK ||
	    HPDF_Page_SetFontAndSize(page, font, 20) != HPDF_OK ||
	    HPDF_Page_TextOut(page, 50, 780, "Password-protected PDF") != HPDF_OK ||
	    HPDF_Page_SetFontAndSize(page, font, 12) != HPDF_OK ||
	    HPDF_Page_TextOut(page, 50, 740, "Generated by libharu on Zephyr.") != HPDF_OK ||
	    HPDF_Page_EndText(page) != HPDF_OK) {
		goto out;
	}

	ret = pdf_output(pdf, "encrypted.pdf");
out:
	if (ret != 0) {
		printk("PDF generation failed: 0x%lx\n", (unsigned long)HPDF_GetError(pdf));
	}
	HPDF_Free(pdf);
	return ret;
}
