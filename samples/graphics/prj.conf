## CMakeLists.txt
```
# SPDX-License-Identifier: Apache-2.0
cmake_minimum_required(VERSION 3.20.0)
list(APPEND ZEPHYR_EXTRA_MODULES ${CMAKE_CURRENT_SOURCE_DIR}/../..)
find_package(Zephyr REQUIRED HINTS $ENV{ZEPHYR_BASE})
project(graphics)
target_sources(app PRIVATE src/main.c ../common/pdf_output.c)
target_include_directories(app PRIVATE ../common)
```

## sample.yaml
```
# SPDX-License-Identifier: Apache-2.0
sample:
  name: Libharu graphics
  description: Generate a PDF using the native libharu API
common:
  tags:
    - libharu
  min_flash: 2048
  min_ram: 256
  integration_platforms:
    - nucleo_u575zi_q
    - qemu_cortex_a53
    - mps2/an385
  harness: console
  harness_config:
    type: one_line
    regex:
      - "PDF-END"
tests:
  sample.libharu.graphics: {}
```

## prj.conf
```kconfig
# SPDX-License-Identifier: Apache-2.0
CONFIG_PICOLIBC=y
CONFIG_COMMON_LIBC_MALLOC_ARENA_SIZE=131072
CONFIG_MAIN_STACK_SIZE=4096
CONFIG_LIBHARU=y
# Vector drawing and raw RGB images are part of the always-enabled core.
CONFIG_PRINTK=y
CONFIG_CONSOLE=y
CONFIG_SERIAL=y
CONFIG_UART_CONSOLE=y
```

## src/main.c
```c
/* SPDX-License-Identifier: Apache-2.0 */
#include <errno.h>
#include <zephyr/sys/printk.h>
#include <zephyr/sys/util.h>

#include "pdf_output.h"

/* A 2 x 2 RGB image; no filesystem, JPEG or PNG decoder is needed. */
static const HPDF_BYTE pixels[] = {
	255, 0, 0, 0, 255, 0,
	0, 0, 255, 255, 255, 0,
};
static const HPDF_REAL values[] = {80, 140, 110, 200, 160};

int main(void)
{
	HPDF_Doc pdf = HPDF_New(NULL, NULL);
	HPDF_Page page;
	HPDF_Image image;
	int ret = -EIO;

	if (pdf == NULL) {
		return -ENOMEM;
	}

	page = HPDF_AddPage(pdf);
	image = HPDF_LoadRawImageFromMem(pdf, pixels, 2, 2, HPDF_CS_DEVICE_RGB, 8);
	if (page == NULL || image == NULL ||
	    HPDF_Page_SetSize(page, HPDF_PAGE_SIZE_A4, HPDF_PAGE_PORTRAIT) != HPDF_OK ||
	    HPDF_Page_SetRGBFill(page, 0.1f, 0.4f, 0.8f) != HPDF_OK) {
		goto out;
	}

	for (size_t i = 0; i < ARRAY_SIZE(values); i++) {
		if (HPDF_Page_Rectangle(page, 50 + i * 90, 400, 60, values[i]) != HPDF_OK ||
		    HPDF_Page_Fill(page) != HPDF_OK) {
			goto out;
		}
	}

	if (HPDF_Page_SetLineWidth(page, 2) != HPDF_OK ||
	    HPDF_Page_MoveTo(page, 40, 400) != HPDF_OK ||
	    HPDF_Page_LineTo(page, 530, 400) != HPDF_OK ||
	    HPDF_Page_Stroke(page) != HPDF_OK ||
	    HPDF_Page_DrawImage(page, image, 50, 150, 160, 160) != HPDF_OK) {
		goto out;
	}

	ret = pdf_output(pdf, "graphics.pdf");
out:
	if (ret != 0) {
		printk("PDF generation failed: 0x%lx\n", (unsigned long)HPDF_GetError(pdf));
	}
	HPDF_Free(pdf);
	return ret;
}
```
