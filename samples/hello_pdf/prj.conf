## CMakeLists.txt
```
# SPDX-License-Identifier: Apache-2.0
cmake_minimum_required(VERSION 3.20.0)
list(APPEND ZEPHYR_EXTRA_MODULES ${CMAKE_CURRENT_SOURCE_DIR}/../..)
find_package(Zephyr REQUIRED HINTS $ENV{ZEPHYR_BASE})
project(hello_pdf)
target_sources(app PRIVATE src/main.c ../common/pdf_output.c)
target_include_directories(app PRIVATE ../common)
```

## sample.yaml
```
# SPDX-License-Identifier: Apache-2.0
sample:
  name: Libharu hello_pdf
  description: Generate a PDF using the native libharu API
common:
  tags:
    - libharu
  min_flash: 2048
  min_ram: 256
  integration_platforms:
    - nucleo_u575zi_q
    - qemu_cortex_a53
    - mps2/an385
  harness: console
  harness_config:
    type: one_line
    regex:
      - "PDF-END"
tests:
  sample.libharu.hello_pdf: {}
  sample.libharu.hello_pdf.minimal:
    extra_args: EXTRA_CONF_FILE=minimal.conf
```

## prj.conf
```kconfig
# SPDX-License-Identifier: Apache-2.0
CONFIG_PICOLIBC=y
CONFIG_COMMON_LIBC_MALLOC_ARENA_SIZE=50072
CONFIG_MAIN_STACK_SIZE=4096
CONFIG_LIBHARU=y
CONFIG_LIBHARU_FONT_HELVETICA=y
CONFIG_PRINTK=y
CONFIG_CONSOLE=y
CONFIG_SERIAL=y
CONFIG_UART_CONSOLE=y
```

## src/main.c
```c
/* SPDX-License-Identifier: Apache-2.0 */
#include <errno.h>
#include <zephyr/sys/printk.h>

#include "pdf_output.h"

int main(void)
{
	HPDF_Doc pdf = HPDF_New(NULL, NULL);
	HPDF_Page page;
	HPDF_Font font;
	int ret = -EIO;

	if (pdf == NULL) {
		printk("Cannot allocate PDF document\n");
		return -ENOMEM;
	}

	page = HPDF_AddPage(pdf);
	font = HPDF_GetFont(pdf, "Helvetica", NULL);
	if (page == NULL || font == NULL) {
		goto out;
	}

	if (HPDF_SetInfoAttr(pdf, HPDF_INFO_TITLE, "Hello from Zephyr") != HPDF_OK ||
	    HPDF_Page_SetSize(page, HPDF_PAGE_SIZE_A4, HPDF_PAGE_PORTRAIT) != HPDF_OK ||
	    HPDF_Page_BeginText(page) != HPDF_OK ||
	    HPDF_Page_SetFontAndSize(page, font, 24) != HPDF_OK ||
	    HPDF_Page_TextOut(page, 50, 780, "Hello from Zephyr!") != HPDF_OK ||
	    HPDF_Page_EndText(page) != HPDF_OK) {
		goto out;
	}

	ret = pdf_output(pdf, "hello.pdf");
out:
	if (ret != 0) {
		printk("PDF generation failed: 0x%lx\n", (unsigned long)HPDF_GetError(pdf));
	}
	HPDF_Free(pdf);
	return ret;
}
```
