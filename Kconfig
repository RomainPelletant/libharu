## Kconfig
```kconfig
# Copyright (c) 2025 Romain Pelletant
# SPDX-License-Identifier: Apache-2.0

config ZEPHYR_LIBHARU_MODULE
	bool

menuconfig LIBHARU
	bool "Libharu PDF library"
	depends on COMMON_LIBC_MALLOC
	depends on COMMON_LIBC_MALLOC_ARENA_SIZE >= 30000
	help
	  This option enables libharu PDF library
	  support.

if LIBHARU

config LIBHARU_FILE_SUPPORT
	bool "Enable file support"
	default n
	depends on FILE_SYSTEM
	help
	  Enable libharu's file APIs (HPDF_SaveToFile() and the *FromFile()
	  loaders). File access goes through Zephyr's file system API, so
	  paths are mount paths such as "/lfs/report.pdf" and the application
	  must mount the file system first.

menu "PDF components"

config LIBHARU_FONT_HELVETICA
	bool "Helvetica family"
	default y
	help
	  Include Helvetica and its bold/oblique variants.

config LIBHARU_FONT_COURIER
	bool "Courier family"
	default y
	help
	  Include Courier and its bold/oblique variants.

config LIBHARU_FONT_TIMES
	bool "Times family"
	default y
	help
	  Include Times and its bold/italic variants.

config LIBHARU_FONT_SYMBOL
	bool "Symbol font"
	default y
	help
	  Include the built-in Symbol font.

config LIBHARU_FONT_ZAPF_DINGBATS
	bool "ZapfDingbats font"
	default y
	help
	  Include the built-in ZapfDingbats font.

config LIBHARU_TRUETYPE
	bool "TrueType and composite fonts"
	default y
	help
	  Enable loading TrueType fonts from memory or files and the shared
	  Type0/CID font engine. Required by UTF-8 and Asian font support.

config LIBHARU_ENCODING_UTF
	bool "UTF-8 encoding"
	default y
	depends on LIBHARU_TRUETYPE
	help
	  Enable HPDF_UseUTFEncodings(). Requires a suitable TrueType font.

config LIBHARU_FONT_JP
	bool "Japanese fonts and encodings"
	default y
	depends on LIBHARU_TRUETYPE
	help
	  Enable HPDF_UseJPFonts() and HPDF_UseJPEncodings().

config LIBHARU_FONT_KR
	bool "Korean fonts and encodings"
	default y
	depends on LIBHARU_TRUETYPE
	help
	  Enable HPDF_UseKRFonts() and HPDF_UseKREncodings().

config LIBHARU_FONT_CNS
	bool "Simplified Chinese fonts and encodings"
	default y
	depends on LIBHARU_TRUETYPE
	help
	  Enable HPDF_UseCNSFonts() and HPDF_UseCNSEncodings().

config LIBHARU_FONT_CNT
	bool "Traditional Chinese fonts and encodings"
	default y
	depends on LIBHARU_TRUETYPE
	help
	  Enable HPDF_UseCNTFonts() and HPDF_UseCNTEncodings().

config LIBHARU_ENCRYPTION
	bool "PDF password encryption"
	default y
	help
	  Enable the existing libharu password and permission APIs.

config LIBHARU_PDFA
	bool "PDF/A and XMP metadata"
	default y
	help
	  Enable PDF/A conformance, XMP extensions and output intents.
	  The shared MD5 implementation is retained for document identifiers,
	  even when password encryption is disabled.

endmenu

endif # LIBHARU
```

## tests/libharu/testcase.yaml
```yaml
# SPDX-License-Identifier: Apache-2.0
common:
  tags:
    - libharu
  min_flash: 2048
  min_ram: 640
  integration_platforms:
    - nucleo_u575zi_q
    - qemu_cortex_a53
    - mps2/an385
tests:
  libraries.libharu: {}
  libraries.libharu.minimal:
    extra_args: EXTRA_CONF_FILE=minimal.conf
  libraries.libharu.pdfa_without_encryption:
    extra_args: EXTRA_CONF_FILE=pdfa.conf
  libraries.libharu.truetype:
    extra_args: EXTRA_CONF_FILE=truetype.conf
  libraries.libharu.no_builtin_fonts:
    extra_args: EXTRA_CONF_FILE="minimal.conf;no_builtin_fonts.conf"
  libraries.libharu.file_support:
    extra_args:
      - EXTRA_CONF_FILE=file_support.conf
      - EXTRA_DTC_OVERLAY_FILE=ramdisk.overlay
```

## west.yml
```yaml
# SPDX-License-Identifier: Apache-2.0

manifest:
  self:
    path: libharu

  remotes:
    - name: zephyrproject-rtos
      url-base: https://github.com/zephyrproject-rtos

  projects:
    - name: zephyr
      remote: zephyrproject-rtos
      revision: b04994206c693adfa9d5e4f1276a05b9d038a303
      import:
        name-allowlist:
          - cmsis_6
          - hal_stm32
          - hal_nordic
          - hal_nxp
```
